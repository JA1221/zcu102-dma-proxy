/include/ "system-conf.dtsi"
/ {
    axidma_chrdev: axidma_chrdev@0 {
        compatible = "xlnx,axidma-chrdev";
        dmas = <&axi_dma_0 0 &axi_dma_0 1>;
        dma-names = "tx_channel", "rx_channel";
    };
    dma_proxy {
       compatible ="xlnx,dma_proxy";
       dmas = <&axi_dma_0 0
               &axi_dma_0 1>;
       dma-names = "dma_proxy_tx", "dma_proxy_rx";
    };
};
